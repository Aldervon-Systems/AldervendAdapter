## Firmware/main/Kconfig
```kconfig
menu "Aldervend Adapter"

config WIFI_SSID
    string "WiFi SSID"
    default ""
    help
        SSID for OTA and connectivity (leave empty to skip connect).

config WIFI_PASSWORD
    string "WiFi Password"
    default ""
    help
        WiFi password.

config VERSION_BASE_URL
    string "OTA version check URL (without ?id=)"
    default "https://api.aldervon.com/device/version"
    help
        Base URL for version check; device appends ?id=<device_id>.

config CHECKIN_URL
    string "Device check-in URL (without ?id=)"
    default "https://api.aldervon.com/device/checkin"
    help
        URL used on boot for device check-in; firmware appends ?id=<device_id>.

endmenu
```

## Firmware/sdkconfig.defaults
```kconfig
# ESP32-C6 Mini target
CONFIG_IDF_TARGET="esp32c6"

# Partition table: factory + OTA slots + NVS
CONFIG_PARTITION_TABLE_CUSTOM=y
CONFIG_PARTITION_TABLE_CUSTOM_FILENAME="partitions.csv"
CONFIG_PARTITION_TABLE_FILENAME="partitions.csv"

# NVS for device ID and WiFi config
CONFIG_NVS_ENCRYPTION=n

# Flash size (mini 4mb)
CONFIG_ESPTOOLPY_FLASHSIZE_4MB=y
CONFIG_ESPTOOLPY_FLASHSIZE="4MB"

# WiFi (for OTA and later use)
CONFIG_ESP_WIFI_ENABLED=y

# HTTP client for OTA
CONFIG_ESP_HTTP_CLIENT_ENABLE_HTTPS=y

# OTA
CONFIG_BOOTLOADER_APP_ROLLBACK_ENABLE=n

# Log level
CONFIG_LOG_DEFAULT_LEVEL_INFO=y

# OTA / WiFi (override in menuconfig for real use)
CONFIG_WIFI_SSID=""
CONFIG_WIFI_PASSWORD=""
CONFIG_VERSION_BASE_URL="https://api.aldervon.com/device/version"
```
